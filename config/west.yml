## config/west.yml
```yaml
manifest:
  remotes:
    - name: zmkfirmware
      url-base: https://github.com/zmkfirmware
    # Additional modules containing boards/shields/custom code can be listed here as well
    # See https://docs.zephyrproject.org/3.2.0/develop/west/manifest.html#projects
    - name: m165437
      url-base: https://github.com/M165437
    - name: Kno1889
      url-base: https://github.com/Kno1889
  projects:
    - name: zmk
      remote: zmkfirmware
      revision: ac7f75b8591d39aaf3b66b9d26f26c9ed921a009
      import: app/west.yml
    - name: nice-view-gem
      remote: m165437
      revision: main
    - name: custom-niceview-shield
      remote: Kno1889
      revision: main
  self:
    path: config
```
